## main/Kconfig.projbuild
```kconfig
menu "Sunton ESP32-S3 based display LVGL Package config"

    config SUNTON_ESP32_DOUBLE_FB
        bool "Use Double Frame Buffer"
        default y

    config SUNTON_ESP32_DOUBLE_FB_TEARING
        bool "Avoid tearing effect"
        depends on SUNTON_ESP32_DOUBLE_FB
        default y

    config SUNTON_ESP32_USE_BOUNCE_BUFFER
        bool "Use bounce buffer"
        default y
        help
            The panel DMA reads small internal-RAM buffers instead of the PSRAM framebuffer. Needs
            CONFIG_LCD_RGB_ISR_IRAM_SAFE (the refill ISR and the flush callback must be in IRAM).

    config LVGL_TASK_MAX_DELAY_MS
        int "LVGL Port Task max delay in MS"
        default 500

    config LVGL_TASK_MIN_DELAY_MS
        int "LVGL Port Task min delay in MS"
        default 1

    config LVGL_TASK_STACK_SIZE
        int "LVGL Port Task stack size in KB"
        default 8

    config LVGL_TASK_PRIORITY
        int "LVGL Port Task prio"
        default 3
endmenu
```
